## Kconfig
```kconfig
#
# Kconfig: Main menu structure definition
# Copyright (C) Juergen Beisert <j.beisert@pengutronix.de> 2008
#

# including of config/Kconfig was not successful, so we pasted its content

# source "config/Kconfig" 

##### content of "config/Kconfig" #####

mainmenu "PTXdist $CONFIGFILE_VERSION"

config MODULES
	bool
	default y

source "generated/project_specific.in"
source "generated/fixme.in"

source "generated/project_name.in"

source "rules/Kconfig"

#######################################

menu "Wago Specific                 "
source "generated/wago_specific.in"
endmenu
```

## platforms/Kconfig
```kconfig
#
# platforms/Kconfig: main menu structure for platform configuration
#

mainmenu "PTXdist $(PTXDIST_VERSION_FULL)"

source "generated/platform_version.in"

menu "architecture                  "
source "generated/architecture_options.in"
endmenu
source "generated/base_kernel.in"
source "generated/devicetree.in"
source "platforms/console.in"

menu "extra kernel                  "
source "generated/kernel.in"
endmenu

menu "bootloaders                   "
source "generated/bootloader.in"
endmenu

menu "bootloader spec entries       "
source "generated/blspec.in"
endmenu

menu "image creation options        "
source "generated/image.in"
source "generated/image2.in"
endmenu

menu "Wago Platform Specific        "
source "generated/wago_platform_specific.in"
endmenu

source "generated/code_signing.in"

source "generated/hosttools_noprompt.in"
source "generated/hosttools_platform.in"

source "generated/platform_project_specific.in"
```
